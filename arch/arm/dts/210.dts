// SPDX-License-Identifier: GPL-2.0+

/dts-v1/;

#include "skeleton.dtsi"
#include "s5pc110-pinctrl.dtsi"

/ {
	model = "210 based on S5PC110";
	compatible = "samsung,210", "samsung,s5pc110";

	aliases {
		serial3 = "/serial@e2900c00";
		console = "/serial@e2900c00";
		pinctrl0 = &pinctrl0;
	};

	pinctrl0: pinctrl@e0200000 {
		compatible = "samsung,s5pc110-pinctrl";
		reg = <0xe0200000 0x1000>;
	};

	serial@e2900c00 {
		compatible = "samsung,exynos4210-uart";
		reg = <0xe2900c00 0x400>;
		id = <3>;
	};
};
