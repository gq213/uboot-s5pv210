## board/samsung/210/Kconfig
```kconfig
if TARGET_S5P_210

config SYS_BOARD
	default "210"

config SYS_VENDOR
	default "samsung"

config SYS_SOC
	default "s5pc1xx"

config SYS_CONFIG_NAME
	default "s5p_210"

endif
```

## configs/210_defconfig
```kconfig
CONFIG_ARM=y
# CONFIG_SYS_ICACHE_OFF is not set
# CONFIG_SYS_DCACHE_OFF is not set
CONFIG_SYS_ARM_MMU=y
CONFIG_ARCH_CPU_INIT=y
# CONFIG_SYS_L2CACHE_OFF is not set
CONFIG_ARCH_S5PC1XX=y
CONFIG_TARGET_S5P_210=y
# CONFIG_LOCALVERSION_AUTO is not set
CONFIG_ENV_VARS_UBOOT_CONFIG=y
CONFIG_NR_DRAM_BANKS=2
CONFIG_SYS_MALLOC_F_LEN=0x400
CONFIG_SYS_TEXT_BASE=0x24800000
CONFIG_BOOTDELAY=3
CONFIG_USE_BOOTARGS=y
CONFIG_BOOTARGS="console=ttySAC3 noinitrd root=/dev/mmcblk0p1 rootfstype=squashfs rootwait init=/linuxrc ignore_loglevel earlyprintk"
CONFIG_USE_BOOTCOMMAND=y
CONFIG_BOOTCOMMAND="run mmcboot"
CONFIG_IDENT_STRING=" for 210"
CONFIG_MISC_INIT_R=y
CONFIG_BOARD_LATE_INIT=y
CONFIG_HUSH_PARSER=y
CONFIG_SYS_PROMPT="210 # "
CONFIG_CMD_BOOTZ=y
# CONFIG_BOOTM_NETBSD is not set
# CONFIG_BOOTM_PLAN9 is not set
# CONFIG_BOOTM_RTEMS is not set
# CONFIG_BOOTM_VXWORKS is not set
# CONFIG_CMD_BOOTEFI is not set
# CONFIG_CMD_ELF is not set
# CONFIG_CMD_XIMG is not set
# CONFIG_CMD_EXPORTENV is not set
# CONFIG_CMD_IMPORTENV is not set
# CONFIG_CMD_EDITENV is not set
CONFIG_CMD_ERASEENV=y
# CONFIG_CMD_ENV_EXISTS is not set
# CONFIG_CMD_LOADB is not set
# CONFIG_CMD_LOADS is not set
CONFIG_CMD_MMC=y
# CONFIG_CMD_ECHO is not set
# CONFIG_CMD_ITEST is not set
# CONFIG_CMD_SOURCE is not set
# CONFIG_CMD_SETEXPR is not set
CONFIG_CMD_PING=y
# CONFIG_CMD_MISC is not set
CONFIG_CMD_FAT=y
CONFIG_DOS_PARTITION=y
CONFIG_DEFAULT_DEVICE_TREE="210"
CONFIG_ENV_IS_IN_MMC=y
CONFIG_ENV_OFFSET=0x4200
CONFIG_ENV_SIZE=0x2000
CONFIG_SYS_RELOC_GD_ENV_ADDR=y
CONFIG_ENV_VARS_UBOOT_RUNTIME_CONFIG=y
# CONFIG_MMC_HW_PARTITIONING is not set
CONFIG_MMC_SDHCI=y
CONFIG_MMC_SDHCI_S5P=y
# CONFIG_DM_ETH is not set
# CONFIG_GENERATE_SMBIOS_TABLE is not set
# CONFIG_EFI_LOADER is not set
```
